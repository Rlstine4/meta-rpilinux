## conf/layer.conf
```bitbake
# We have a conf and classes directory, add to BBPATH 
BBPATH .= ":${LAYERDIR}" 

# We have recipes-* directories, add to BBFILES 
BBFILES += "${LAYERDIR}/recipes-*/*/*.bb \ 
  ${LAYERDIR}/recipes-*/*/*.bbappend"

BBFILE_COLLECTIONS += "rpilinux" 
BBFILE_PATTERN_rpilinux = "^${LAYERDIR}/" 
BBFILE_PRIORITY_rpilinux = "6" 

LAYERSERIES_COMPAT_rpilinux = "scarthgap" 


DISTRO_FEATURES:append = " systemd usrmerge"
DISTRO_FEATURES:remove = " sysvinit"

VIRTUAL-RUNTIME_init_manager = "systemd"
VIRTUAL-RUNTIME_initscripts = "systemd-compat-units"
```
